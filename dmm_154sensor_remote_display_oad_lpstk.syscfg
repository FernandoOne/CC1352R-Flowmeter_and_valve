/**
 * @cliArgs --board "/ti/boards/CC1352R1_LAUNCHXL" --product "simplelink_cc13x2_26x2_sdk@5.20.00.52"
 * @versions {"data":"2021060817","timestamp":"2021060817","tool":"1.8.2+1992","templates":null}
 */
const bp_LPSTKCC1352RSENSORS = scripting.addHardware("/ti/boards/boosterpacks/LPSTK-SENSORS");

/**
 * Import the modules used in this configuration.
 */
const ble         = scripting.addModule("/ti/ble5stack/ble");
const CCFG        = scripting.addModule("/ti/devices/CCFG");
const rfdesign    = scripting.addModule("/ti/devices/radioconfig/rfdesign");
const dmm         = scripting.addModule("/ti/dmm/dmm");
const ADC         = scripting.addModule("/ti/drivers/ADC");
const ADC1        = ADC.addInstance();
const ADC2        = ADC.addInstance();
const AESCCM      = scripting.addModule("/ti/drivers/AESCCM");
const AESCCM1     = AESCCM.addInstance();
const AESCTRDRBG  = scripting.addModule("/ti/drivers/AESCTRDRBG");
const AESCTRDRBG1 = AESCTRDRBG.addInstance();
const AESECB      = scripting.addModule("/ti/drivers/AESECB");
const AESECB1     = AESECB.addInstance();
const ECDH        = scripting.addModule("/ti/drivers/ECDH");
const ECDH1       = ECDH.addInstance();
const GPIO        = scripting.addModule("/ti/drivers/GPIO");
const GPIO1       = GPIO.addInstance();
const GPIO2       = GPIO.addInstance();
const GPIO3       = GPIO.addInstance();
const GPIO4       = GPIO.addInstance();
const I2C         = scripting.addModule("/ti/drivers/I2C");
const I2C1        = I2C.addInstance();
const NVS         = scripting.addModule("/ti/drivers/NVS");
const NVS1        = NVS.addInstance();
const NVS2        = NVS.addInstance();
const RF          = scripting.addModule("/ti/drivers/RF");
const RTOS        = scripting.addModule("/ti/drivers/RTOS");
const TRNG        = scripting.addModule("/ti/drivers/TRNG");
const TRNG1       = TRNG.addInstance();
const TRNG2       = TRNG.addInstance();
const UART        = scripting.addModule("/ti/drivers/UART");
const UART1       = UART.addInstance();
const Button      = scripting.addModule("/ti/drivers/apps/Button");
const Button1     = Button.addInstance();
const Button2     = Button.addInstance();
const LED         = scripting.addModule("/ti/drivers/apps/LED");
const LED1        = LED.addInstance();
const LED2        = LED.addInstance();
const ti154stack  = scripting.addModule("/ti/ti154stack/ti154stack");

/**
 * Write custom configuration values to the imported modules.
 */
ble.deviceName                                            = "DMM 15.4 Sensor RD";
ble.addressMode                                           = "ADDRMODE_PUBLIC";
ble.maxConnNum                                            = 4;
ble.numOfAdvSets                                          = 1;
ble.lockProject                                           = true;
ble.oneLibSizeOpt                                         = false;
ble.maxPDUSize                                            = 255;
ble.numOfDefAdvSets                                       = 1;
ble.radioConfig.codeExportConfig.$name                    = "ti_devices_radioconfig_code_export_param1";
ble.connUpdateParamsPeripheral.$name                      = "ti_ble5stack_general_ble_conn_update_params0";
ble.connUpdateParamsPeripheral.reqMinConnInt              = 100;
ble.connUpdateParamsPeripheral.reqMaxConnInt              = 130;
ble.advSet1.$name                                         = "ti_ble5stack_broadcaster_advertisement_set0";
ble.advSet1.advParam1.$name                               = "ti_ble5stack_broadcaster_advertisement_params0";
ble.advSet1.advData1.$name                                = "ti_ble5stack_broadcaster_advertisement_data0";
ble.advSet1.advData1.GAP_ADTYPE_FLAGS                     = true;
ble.advSet1.advData1.advertisingFlags                     = ["GAP_ADTYPE_FLAGS_BREDR_NOT_SUPPORTED","GAP_ADTYPE_FLAGS_GENERAL"];
ble.advSet1.advData1.GAP_ADTYPE_16BIT_MORE                = true;
ble.advSet1.advData1.numOfUUIDs16More                     = 1;
ble.advSet1.advData1.UUID016More                          = 0x1190;
ble.advSet1.scanRes1.$name                                = "ti_ble5stack_broadcaster_advertisement_data1";
ble.advSet1.scanRes1.GAP_ADTYPE_LOCAL_NAME_COMPLETE       = true;
ble.advSet1.scanRes1.completeLocalName                    = "DMM 15.4 Sensor RD";
ble.advSet1.scanRes1.GAP_ADTYPE_SLAVE_CONN_INTERVAL_RANGE = true;
ble.advSet1.scanRes1.maxConnInterval                      = 130;
ble.advSet1.scanRes1.GAP_ADTYPE_POWER_LEVEL               = true;

CCFG.enableBootloader         = true;
CCFG.enableBootloaderBackdoor = true;
CCFG.dioBootloaderBackdoor    = 15;
CCFG.levelBootloaderBackdoor  = "Active low";
CCFG.forceVddr                = true;
CCFG.ccfgTemplate.$name       = "ti_devices_CCFGTemplate0";

dmm.project                                        = "ti_dmm_154sensor_remote_display";
dmm.stackRoles                                     = ["blePeripheral","ti154Sensor"];
dmm.lockStackRoles                                 = true;
dmm.projectStackConfiguration                      = ["ble","ti154stack"];
dmm.numApplicationStates                           = 10;
dmm.applicationState0                              = "ANY";
dmm.applicationState1                              = "DMMPOLICY_BLE_IDLE";
dmm.applicationState2                              = "DMMPOLICY_BLE_ADV";
dmm.applicationState3                              = "DMMPOLICY_BLE_CONNECTING";
dmm.applicationState4                              = "DMMPOLICY_BLE_HIGH_BANDWIDTH";
dmm.applicationState5                              = "DMMPOLICY_BLE_CONNECTED";
dmm.applicationState6                              = "DMMPOLICY_BLE_OAD";
dmm.applicationState7                              = "DMMPOLICY_154_UNINIT";
dmm.applicationState8                              = "DMMPOLICY_154_PROVISIONING";
dmm.applicationState9                              = "DMMPOLICY_154_CONNECTED";
dmm.policyArray.create(3);
dmm.policyArray[0].$name                           = "ti_dmm_policy_dmm_policy0";
dmm.policyArray[0].blePeripheral.$name             = "ti_dmm_policy_stack_dmm_stack_ble0";
dmm.policyArray[0].blePeripheral.applicationStates = ["applicationState6"];
dmm.policyArray[0].ti154Sensor.$name               = "ti_dmm_policy_stack_dmm_stack_ti154stack0";
dmm.policyArray[0].ti154Sensor.pause               = "DMMPOLICY_PAUSED";
dmm.policyArray[1].$name                           = "ti_dmm_policy_dmm_policy1";
dmm.policyArray[1].blePeripheral.$name             = "ti_dmm_policy_stack_dmm_stack_ble1";
dmm.policyArray[1].blePeripheral.applicationStates = ["applicationState3","applicationState4"];
dmm.policyArray[1].blePeripheral.weight            = 25;
dmm.policyArray[1].blePeripheral.appliedActivity   = ["DMMPOLICY_APPLIED_ACTIVITY_BLE_CONNECTION"];
dmm.policyArray[1].ti154Sensor.$name               = "ti_dmm_policy_stack_dmm_stack_ti154stack1";
dmm.policyArray[2].$name                           = "ti_dmm_policy_dmm_policy2";
dmm.policyArray[2].blePeripheral.$name             = "ti_dmm_policy_stack_dmm_stack_ble2";
dmm.policyArray[2].ti154Sensor.$name               = "ti_dmm_policy_stack_dmm_stack_ti154stack2";
dmm.policyArray[2].ti154Sensor.weight              = 1;

ADC1.$name                = "CONFIG_ADC_0";
ADC1.$hardware            = bp_LPSTKCC1352RSENSORS.components.DRV5055.subComponents.OUTPUT;
ADC1.adcPinInstance.$name = "CONFIG_PIN_DRV_OUT";

ADC2.$name                = "BATTERY_ADC";
ADC2.adcPinInstance.$name = "CONFIG_PIN_4";

AESCCM1.$name = "CONFIG_AESCCM0";

AESCTRDRBG1.$name              = "CONFIG_AESCTRDRBG_0";
AESCTRDRBG1.aesctrObject.$name = "CONFIG_AESCTR_0";

AESECB1.$name = "CONFIG_AESECB0";

ECDH1.$name = "CONFIG_ECDH0";

GPIO1.$name             = "CONFIG_GPIO_BLED";
GPIO1.mode              = "Output";
GPIO1.$hardware         = bp_LPSTKCC1352RSENSORS.components.LED_B;
GPIO1.pinInstance.$name = "CONFIG_PIN_BLED";

GPIO2.$name             = "CONFIG_GPIO_OPT_INT";
GPIO2.$hardware         = bp_LPSTKCC1352RSENSORS.components.OPT3001.subComponents.ALERT;
GPIO2.pinInstance.$name = "CONFIG_PIN_OPT_INT";

GPIO3.$name             = "CONFIG_GPIO_HDC_INT";
GPIO3.$hardware         = bp_LPSTKCC1352RSENSORS.components.HDC2080.subComponents.ALERT;
GPIO3.pinInstance.$name = "CONFIG_PIN_HDC_INT";

GPIO4.$name             = "InterruptPin";
GPIO4.pull              = "Pull Down";
GPIO4.interruptTrigger  = "Rising Edge";
GPIO4.callbackFunction  = "addPulse";
GPIO4.gpioPin.$assign   = "boosterpack.27";
GPIO4.pinInstance.$name = "CONFIG_PIN_0";

I2C1.$name                = "CONFIG_I2C_0";
I2C1.$hardware            = bp_LPSTKCC1352RSENSORS.components.LPSTK_I2C;
I2C1.sdaPinInstance.$name = "CONFIG_PIN_I2C_0_SDA";
I2C1.clkPinInstance.$name = "CONFIG_PIN_I2C_0_CLK";

NVS1.$name                    = "CONFIG_NVSINTERNAL";
NVS1.internalFlash.$name      = "ti_drivers_nvs_NVSCC26XX0";
NVS1.internalFlash.regionBase = 0x52000;
NVS1.internalFlash.regionSize = 0x4000;

NVS2.nvsType                        = "External";
NVS2.$name                          = "CONFIG_NVSEXTERNAL";
NVS2.externalFlash.$name            = "ti_drivers_nvs_NVSSPI25X0";
NVS2.externalFlash.regionSize       = 0x100000;
NVS2.externalFlash.verifyBufferSize = 64;
NVS2.externalFlash.$hardware        = system.deviceData.board.components.MX25R8035F;

TRNG1.$name = "CONFIG_TRNG_0";

TRNG2.$name = "CONFIG_TRNG_1";

UART1.$hardware           = system.deviceData.board.components.XDS110UART;
UART1.$name               = "CONFIG_DISPLAY_UART";
UART1.txPinInstance.$name = "CONFIG_PIN_UART_TX";
UART1.rxPinInstance.$name = "CONFIG_PIN_UART_RX";

Button1.$name                     = "CONFIG_BTN_LEFT";
Button1.$hardware                 = system.deviceData.board.components["BTN-1"];
Button1.gpioPin.$name             = "CONFIG_GPIO_BTN1";
Button1.gpioPin.pinInstance.$name = "CONFIG_PIN_BTN1";

Button2.$name                     = "CONFIG_BTN_RIGHT";
Button2.$hardware                 = system.deviceData.board.components["BTN-2"];
Button2.gpioPin.$name             = "CONFIG_GPIO_BTN2";
Button2.gpioPin.pinInstance.$name = "CONFIG_PIN_BTN2";

LED1.$name                     = "CONFIG_LED_RED";
LED1.$hardware                 = system.deviceData.board.components.LED_RED;
LED1.gpioPin.$name             = "CONFIG_GPIO_RLED";
LED1.gpioPin.pinInstance.$name = "CONFIG_PIN_RLED";

LED2.$name                     = "CONFIG_LED_GREEN";
LED2.$hardware                 = system.deviceData.board.components.LED_GREEN;
LED2.gpioPin.$name             = "CONFIG_GPIO_GLED";
LED2.gpioPin.pinInstance.$name = "CONFIG_PIN_GLED";

const NVSSPI25XDevice                                      = scripting.addModule("/ti/drivers/nvs/NVSSPI25XDevice", {}, false);
const NVSSPI25XDevice1                                     = NVSSPI25XDevice.addInstance({}, false);
NVSSPI25XDevice1.$name                                     = "CONFIG_NVS_SPI_0";
NVS2.externalFlash.spiFlashDevice                          = NVSSPI25XDevice1;
NVSSPI25XDevice1.slaveSelectGpioInstance.$name             = "CONFIG_GPIO_SPI_SS";
NVSSPI25XDevice1.slaveSelectGpioInstance.pinInstance.$name = "CONFIG_PIN_SPI_SS";

const SPI                          = scripting.addModule("/ti/drivers/SPI", {}, false);
const SPI1                         = SPI.addInstance({}, false);
SPI1.$name                         = "CONFIG_SPI_1";
NVSSPI25XDevice1.sharedSpiInstance = SPI1;
SPI1.sclkPinInstance.$name         = "CONFIG_PIN_1";
SPI1.misoPinInstance.$name         = "CONFIG_PIN_2";
SPI1.mosiPinInstance.$name         = "CONFIG_PIN_3";

ti154stack.project                            = "sensor";
ti154stack.lockProject                        = true;
ti154stack.transmitPower                      = "14";
ti154stack.phyType                            = "phy5kbps";
ti154stack.mode                               = "frequencyHopping";
ti154stack.reportingInterval                  = 30000;
ti154stack.aesccmModule.$name                 = "CONFIG_AESCCM_0";
ti154stack.ti154stackModule.$name             = "ti_ti154stack_ti154stack_config_mod0";
ti154stack.radioConfig.codeExportConfig.$name = "ti_devices_radioconfig_code_export_param0";

/**
 * Pinmux solution for unlocked pins/peripherals. This ensures that minor changes to the automatic solver in a future
 * version of the tool will not impact the pinmux you originally saw.  These lines can be completely deleted in order to
 * re-solve from scratch.
 */
ADC1.adc.$suggestSolution                                         = "ADC0";
ADC1.adc.adcPin.$suggestSolution                                  = "boosterpack.2";
ADC2.adc.$suggestSolution                                         = "ADC0";
ADC2.adc.adcPin.$suggestSolution                                  = "boosterpack.6";
GPIO1.gpioPin.$suggestSolution                                    = "boosterpack.8";
GPIO2.gpioPin.$suggestSolution                                    = "boosterpack.25";
GPIO3.gpioPin.$suggestSolution                                    = "boosterpack.23";
I2C1.i2c.$suggestSolution                                         = "I2C0";
I2C1.i2c.sdaPin.$suggestSolution                                  = "boosterpack.10";
I2C1.i2c.sclPin.$suggestSolution                                  = "boosterpack.9";
UART1.uart.$suggestSolution                                       = "UART0";
UART1.uart.txPin.$suggestSolution                                 = "boosterpack.4";
UART1.uart.rxPin.$suggestSolution                                 = "boosterpack.3";
Button1.gpioPin.gpioPin.$suggestSolution                          = "boosterpack.13";
Button2.gpioPin.gpioPin.$suggestSolution                          = "boosterpack.12";
LED1.gpioPin.gpioPin.$suggestSolution                             = "boosterpack.39";
LED2.gpioPin.gpioPin.$suggestSolution                             = "boosterpack.40";
NVSSPI25XDevice1.slaveSelectGpioInstance.gpioPin.$suggestSolution = "boosterpack.38";
SPI1.spi.$suggestSolution                                         = "SSI0";
SPI1.spi.sclkPin.$suggestSolution                                 = "boosterpack.7";
SPI1.spi.misoPin.$suggestSolution                                 = "boosterpack.14";
SPI1.spi.mosiPin.$suggestSolution                                 = "boosterpack.15";
SPI1.spi.dmaRxChannel.$suggestSolution                            = "DMA_CH3";
SPI1.spi.dmaTxChannel.$suggestSolution                            = "DMA_CH4";
